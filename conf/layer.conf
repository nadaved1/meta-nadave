## conf/layer.conf
```bitbake
# We have a conf and classes directory, add to BBPATH
BBPATH .= ":${LAYERDIR}"

# We have recipes-* directories, add to BBFILES
BBFILES += "${LAYERDIR}/recipes-*/*/*.bb \
            ${LAYERDIR}/recipes-*/*/*.bbappend"

BBFILE_COLLECTIONS += "meta-nadave"
BBFILE_PATTERN_meta-nadave = "^${LAYERDIR}/"
BBFILE_PRIORITY_meta-nadave = "7"

LAYERDEPENDS_meta-nadave = "core"
LAYERSERIES_COMPAT_meta-nadave = "kirkstone"

IMAGE_INSTALL:append:pn-core-image-minimal = " gcc"
```

## conf/machine/bullet-4k.conf
```bitbake
require ../meta-hailo-bsp/conf/machine/hailo15-base.inc

UBOOT_MACHINE = "bullet-4k_defconfig"
KERNEL_DEVICE_TREE = "hailo/bullet-4k.dtb"
```

## conf/machine/bullet_4k.conf
```bitbake
require ../meta-hailo-bsp/conf/machine/hailo15-base.inc

UBOOT_MACHINE = "bullet_4k_defconfig"
KERNEL_DEVICE_TREE = "hailo/bullet_4k.dtb"
```

## conf/machine/mean-machine.conf
```bitbake
require ../meta-hailo-bsp/meta-mercury-bsp/conf/machine/hailo15-base.inc

UBOOT_MACHINE = "hailo15_evb_security_camera_defconfig"
#DEVICE_TREE = "<device-tree-file>"
```
